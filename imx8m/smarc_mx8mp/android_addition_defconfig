## imx8m/smarc_mx8mp/android_addition_defconfig
```kconfig
CONFIG_LIBNVDIMM=y
CONFIG_OF_PMEM=y
CONFIG_WLAN=y
CONFIG_WLAN_VENDOR_ATH=y
CONFIG_ATH10K=y
CONFIG_ATH10K_CE=y
CONFIG_ATH10K_PCI=m
CONFIG_VIDEO_OV5645=y
CONFIG_SND_SOC_IMX_SGTL5000=y
CONFIG_RTC_DRV_S35390A=y
```

## imx8m/smarc_mx8mq/android_addition_defconfig
```kconfig
CONFIG_CAN_MCP251X=m
CONFIG_WLAN=y
CONFIG_WLAN_VENDOR_ATH=y
CONFIG_ATH10K=y
CONFIG_ATH10K_CE=y
CONFIG_ATH10K_PCI=m
CONFIG_VIDEO_OV5645=y
CONFIG_DRM_TI_SN65DSI84=y
CONFIG_SND_SOC_IMX_SGTL5000=y
CONFIG_RTC_DRV_S35390A=m
```
